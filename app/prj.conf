## CMakeLists.txt
```
# SPDX-License-Identifier: Apache-2.0

set(CMAKE_C_FLAGS -lstdc++)
set(CMAKE_CXX_FLAGS -lstdc++)

cmake_minimum_required(VERSION 3.20.0)
find_package(Zephyr REQUIRED HINTS $ENV{ZEPHYR_BASE})
project(app)

zephyr_library_compile_options(-lstdc++ -std=c++17 -Wall -Wextra -Wno-missing-field-initializers -Wno-unused-variable -Wno-comment)

FILE(GLOB app_sources src/*.cpp)
target_sources(app PRIVATE ${app_sources})
```

## Kconfig
```
config NET_CONFIG_SSID
    string "SSID"
    default "SSID"
    help
      set the SSID

config NET_CONFIG_PSK
    string "PSK"
    default "PSK"
    help
      set the PSK

source "Kconfig.zephyr"
```

## west.yml
```
manifest:
  defaults:
    remote: zephyrproject-rtos
  remotes:
    - name: zephyrproject-rtos
      url-base: https://github.com/zephyrproject-rtos
    - name: nrfconnect
      url-base: http://github.com/nrfconnect
  projects:
    - name: zephyr
      remote: zephyrproject-rtos
      revision: v3.4.0
      clone-depth: 1
      import: true
    # - name: sdk-nrf
    #   remote: nrfconnect
    #   revision: v2.4.1
    #   import: true
  self:
    path: app
```

## prj.conf
```kconfig
#
# Copyright (c) 2023 Craig Peacock.
#
# SPDX-License-Identifier: Apache-2.0
#

###############################################################################
###############################################################################
###############################################################################
CONFIG_WIFI=y
CONFIG_INIT_STACKS=y
CONFIG_NET_L2_WIFI_MGMT=y

CONFIG_NETWORKING=y
CONFIG_NET_IPV4=y
CONFIG_NET_IPV6=y
CONFIG_NET_UDP=y
CONFIG_NET_TCP=y
CONFIG_DNS_RESOLVER=y
CONFIG_DNS_RESOLVER_AI_MAX_ENTRIES=10

CONFIG_NET_SOCKETS=y
CONFIG_HTTP_CLIENT=y

# Use DHCP for IPv4
CONFIG_NET_DHCPV4=y
# Following line must be enabled, otherwise WiFi connection fails with -1.
CONFIG_NET_CONFIG_SETTINGS=y

CONFIG_NET_TX_STACK_SIZE=2048
CONFIG_NET_RX_STACK_SIZE=2048

CONFIG_NET_PKT_RX_COUNT=10
CONFIG_NET_PKT_TX_COUNT=10

CONFIG_NET_BUF_RX_COUNT=20
CONFIG_NET_BUF_TX_COUNT=20

CONFIG_NET_MAX_CONTEXTS=10

# Enabling logging can be helpful for debugging
CONFIG_LOG=y
#CONFIG_LOG_MODE_IMMEDIATE=y
#CONFIG_NET_LOG=y
#CONFIG_WIFI_LOG_LEVEL_ERR=y
#CONFIG_NET_IPV6_LOG_LEVEL_DBG=y

# Added to prevent error with missing #include <ethernet/eth_stats.h> for esp_wifi_drv.c
# Adding this line will cause CMAKE Warning: No SOURCES given to Zephyr library: drivers__ethernet
# Just ignore.
CONFIG_NET_L2_ETHERNET=y

###############################################################################
###############################################################################
###############################################################################
CONFIG_NET_SOCKETS_POSIX_NAMES=y
CONFIG_NET_SOCKETS_POLL_MAX=4

# HTTP & Websocket
CONFIG_WEBSOCKET_CLIENT=y

###############################################################################
###############################################################################
###############################################################################
# Enable the sys_reboot() API.
CONFIG_REBOOT=y
```

## boards/stamp_c3.conf
```kconfig
CONFIG_WIFI=y
CONFIG_HEAP_MEM_POOL_SIZE=98304

CONFIG_NETWORKING=y
CONFIG_NET_L2_ETHERNET=y

CONFIG_NET_IPV6=n
CONFIG_NET_IPV4=y
CONFIG_NET_DHCPV4=y
CONFIG_ESP32_WIFI_STA_AUTO_DHCPV4=y

CONFIG_NET_LOG=y

CONFIG_BOOTLOADER_MCUBOOT=y

###############################################################################
###############################################################################
###############################################################################
# LED Strip
CONFIG_LED_STRIP=y
CONFIG_LED_STRIP_LOG_LEVEL_DBG=y
CONFIG_WS2812_STRIP=y
CONFIG_WS2812_STRIP_GPIO=y
```

## boards/beagleconnect_freedom.overlay
```dts
// &arduino_spi {
// 	status = "okay";
// 	cs-gpios = <&arduino_header 16 0>;			/* D10 */

// 	winc1500_adafruit_winc1500: winc1500@0 {
// 		status = "ok";
// 		compatible = "atmel,winc1500";
// 		reg = <0x0>;
// 		spi-max-frequency = <4000000>;
// 		irq-gpios = <&arduino_header 13 GPIO_ACTIVE_LOW>;	/* D7 */
// 		reset-gpios = <&arduino_header 11 GPIO_ACTIVE_LOW>;	/* D5 */
// 		enable-gpios = <&arduino_header 12 0>;			/* D6 */
// 	};
// };
```

## boards/stamp_c3.overlay
```dts
/*
 * Copyright (c) 2022 Espressif Systems (Shanghai) Co., Ltd.
 *
 * SPDX-License-Identifier: Apache-2.0
 */

#include <zephyr/dt-bindings/gpio/gpio.h>
#include <zephyr/dt-bindings/led/led.h>

&wifi {
	status = "okay";
};
```

## src/main.c
```c
/*
 * Copyright (c) 2023 Maximilian Huber
 * Copyright (c) 2023 Craig Peacock.
 * Copyright (c) 2019 Intel Corporation
 * Copyright (c) 2017 ARM Ltd.
 * Copyright (c) 2016 Intel Corporation.
 *
 * SPDX-License-Identifier: Apache-2.0
 */

#include <zephyr/logging/log.h>
LOG_MODULE_REGISTER(app, LOG_LEVEL_DBG);

#include <errno.h>
#include <zephyr/kernel.h>
#include <zephyr/drivers/led_strip.h>
#include <zephyr/net/net_event.h>
#include <zephyr/net/net_if.h>
#include <zephyr/net/net_ip.h>
#include <zephyr/net/socket.h>
#include <zephyr/net/websocket.h>
#include <zephyr/net/wifi_mgmt.h>
#include <zephyr/random/rand32.h>
#include <zephyr/shell/shell.h>

#if defined(CONFIG_NET_CONFIG_SSID)
#define SSID CONFIG_NET_CONFIG_SSID
#else
#define SSID "SSID"
#endif

#if defined(CONFIG_NET_CONFIG_PSK)
#define PSK CONFIG_NET_CONFIG_PSK
#else
#define PSK "PSK"
#endif

static K_SEM_DEFINE(wifi_connected, 0, 1);
static K_SEM_DEFINE(ipv4_address_obtained, 0, 1);

static struct net_mgmt_event_callback wifi_cb;
static struct net_mgmt_event_callback ipv4_cb;

static void handle_wifi_connect_result(struct net_mgmt_event_callback *cb)
{
	const struct wifi_status *status = (const struct wifi_status *)cb->info;

	if (status->status)
	{
		LOG_ERR("Connection request failed (%d)\n", status->status);
	}
	else
	{
		LOG_INF("Connected\n");
		k_sem_give(&wifi_connected);
	}
}

static void handle_wifi_disconnect_result(struct net_mgmt_event_callback *cb)
{
	const struct wifi_status *status = (const struct wifi_status *)cb->info;

	if (status->status)
	{
		LOG_INF("Disconnection request (%d)\n", status->status);
	}
	else
	{
		LOG_INF("Disconnected\n");
		k_sem_take(&wifi_connected, K_NO_WAIT);
	}
}

static void handle_ipv4_result(struct net_if *iface)
{
	int i = 0;

	for (i = 0; i < NET_IF_MAX_IPV4_ADDR; i++)
	{

		char buf[NET_IPV4_ADDR_LEN];

		if (iface->config.ip.ipv4->unicast[i].addr_type != NET_ADDR_DHCP)
		{
			continue;
		}

		LOG_DBG("IPv4 address: %s\n",
				net_addr_ntop(AF_INET,
							  &iface->config.ip.ipv4->unicast[i].address.in_addr,
							  buf, sizeof(buf)));
		LOG_DBG("Subnet: %s\n",
				net_addr_ntop(AF_INET,
							  &iface->config.ip.ipv4->netmask,
							  buf, sizeof(buf)));
		LOG_DBG("Router: %s\n",
				net_addr_ntop(AF_INET,
							  &iface->config.ip.ipv4->gw,
							  buf, sizeof(buf)));
	}

	k_sem_give(&ipv4_address_obtained);
}

static void wifi_mgmt_event_handler(struct net_mgmt_event_callback *cb, uint32_t mgmt_event, struct net_if *iface)
{
	switch (mgmt_event)
	{

	case NET_EVENT_WIFI_CONNECT_RESULT:
		handle_wifi_connect_result(cb);
		break;

	case NET_EVENT_WIFI_DISCONNECT_RESULT:
		handle_wifi_disconnect_result(cb);
		break;

	case NET_EVENT_IPV4_ADDR_ADD:
		handle_ipv4_result(iface);
		break;

	default:
		break;
	}
}

void wifi_connect(void)
{
	struct net_if *iface = net_if_get_default();

	struct wifi_connect_req_params wifi_params = {0};

	wifi_params.ssid = SSID;
	wifi_params.psk = PSK;
	wifi_params.ssid_length = strlen(SSID);
	wifi_params.psk_length = strlen(PSK);
	wifi_params.channel = WIFI_CHANNEL_ANY;
	wifi_params.security = WIFI_SECURITY_TYPE_PSK;
	wifi_params.band = WIFI_FREQ_BAND_2_4_GHZ;
	wifi_params.mfp = WIFI_MFP_OPTIONAL;

	LOG_DBG("Connecting to SSID: %s\n", wifi_params.ssid);

	if (net_mgmt(NET_REQUEST_WIFI_CONNECT, iface, &wifi_params, sizeof(struct wifi_connect_req_params)))
	{
		LOG_ERR("WiFi Connection Request Failed\n");
	}
}

void wifi_status(void)
{
	struct net_if *iface = net_if_get_default();

	struct wifi_iface_status status = {0};

	if (net_mgmt(NET_REQUEST_WIFI_IFACE_STATUS, iface, &status, sizeof(struct wifi_iface_status)))
	{
		LOG_ERR("WiFi Status Request Failed\n");
	}

	if (status.state >= WIFI_STATE_ASSOCIATED)
	{
		LOG_DBG("SSID: %-32s\n", status.ssid);
		LOG_DBG("Band: %s\n", wifi_band_txt(status.band));
		LOG_DBG("Channel: %d\n", status.channel);
		LOG_DBG("Security: %s\n", wifi_security_txt(status.security));
		LOG_DBG("RSSI: %d\n", status.rssi);
	}
}

void wifi_disconnect(void)
{
	struct net_if *iface = net_if_get_default();

	if (net_mgmt(NET_REQUEST_WIFI_DISCONNECT, iface, NULL, 0))
	{
		LOG_ERR("WiFi Disconnection Request Failed\n");
	}
}

void main(void)
{
	int sock;

	LOG_INF("Board: %s\n", CONFIG_BOARD);

	net_mgmt_init_event_callback(&wifi_cb, wifi_mgmt_event_handler,
								 NET_EVENT_WIFI_CONNECT_RESULT | NET_EVENT_WIFI_DISCONNECT_RESULT);

	net_mgmt_init_event_callback(&ipv4_cb, wifi_mgmt_event_handler, NET_EVENT_IPV4_ADDR_ADD);

	net_mgmt_add_event_callback(&wifi_cb);
	net_mgmt_add_event_callback(&ipv4_cb);

#ifdef CONFIG_BOARD_NRF7002DK_NRF5340_CPUAPP
	// Delay to prevent "Unable to get wpa_s handle for wlan0" on nRF Connect SDK 2.3.0.?
	LOG_DBG("Sleeping for 1 second while wlan0 comes up\n");
	k_sleep(K_SECONDS(1));
#else
	LOG_DBG("Sleeping for 1 second anyways\n");
	k_sleep(K_SECONDS(1));
#endif

	wifi_connect();
	k_sem_take(&wifi_connected, K_FOREVER);
	wifi_status();
	k_sem_take(&ipv4_address_obtained, K_FOREVER);
	LOG_INF("Ready...");
}
```

## src/main.cpp
```c
/*
 * Copyright (c) 2023 Maximilian Huber
 *
 * SPDX-License-Identifier: Apache-2.0
 */
#include <zephyr/logging/log.h>
LOG_MODULE_REGISTER(app, LOG_LEVEL_DBG);

#include <stdio.h>
#include <zephyr/kernel.h>
#include <zephyr/arch/cpu.h>
#include <zephyr/sys/printk.h>

#include "wifi.h"
#include "uiclient.h"

#if defined(CONFIG_NET_CONFIG_SSID)
#define SSID CONFIG_NET_CONFIG_SSID
#else
#define SSID "SSID"
#endif

#if defined(CONFIG_NET_CONFIG_PSK)
#define PSK CONFIG_NET_CONFIG_PSK
#else
#define PSK "PSK"
#endif

int main(void)
{
    LOG_INF("Running on: %s", CONFIG_BOARD);

    LOG_INF("Step 1, connect to WIFI");
    WIFI wifi(SSID, PSK);
    wifi.connect();

    LOG_INF("Step 2, establish websocket connection");
    UICLIENT uiclient("192.168.1.205", 9001);

    return 0;
}
```

## src/status_led.c
```c
/*
 * Copyright (c) 2017 Linaro Limited
 * Copyright (c) 2018 Intel Corporation
 *
 * SPDX-License-Identifier: Apache-2.0
 */

#include <errno.h>
#include <string.h>

#define LOG_LEVEL 4
#include <zephyr/logging/log.h>
LOG_MODULE_REGISTER(status_led);

#include <zephyr/kernel.h>
#include <zephyr/drivers/led_strip.h>
#include <zephyr/device.h>
#include <zephyr/drivers/spi.h>
#include <zephyr/sys/util.h>

#define STRIP_NODE		DT_ALIAS(led_strip)
#define STRIP_NUM_PIXELS	DT_PROP(DT_ALIAS(led_strip), chain_length)

#define DELAY_TIME K_MSEC(50)

#define RGB(_r, _g, _b) { .r = (_r), .g = (_g), .b = (_b) }

static const struct led_rgb colors[] = {
	RGB(0x0f, 0x00, 0x00), /* red */
	RGB(0x00, 0x0f, 0x00), /* green */
	RGB(0x00, 0x00, 0x0f), /* blue */
};
```

## src/status_led.cpp
```c
/*
 * Copyright (c) 2023 Maximilian Huber
 * Copyright (c) 2018 Intel Corporation
 * Copyright (c) 2017 Linaro Limited
 *
 * SPDX-License-Identifier: Apache-2.0
 */

#include <errno.h>
#include <string.h>

#define LOG_LEVEL 4
#include <zephyr/logging/log.h>
LOG_MODULE_REGISTER(status_led);

#include "status_led.h"

STATUS_LED::STATUS_LED(const struct device *_strip, int _strip_num_pixels)
{
  LOG_MODULE_DECLARE(status_led);
  strip = _strip;
  strip_num_pixels = _strip_num_pixels;
  if (device_is_ready(strip))
  {
    LOG_INF("Found LED strip device %s", strip->name);
  }
  //   pin = _pin;
  //   dev = device_get_binding(label);
  // static const struct device *const strip = DEVICE_DT_GET(STRIP_NODE);
}

void STATUS_LED::blue()
{
  LOG_MODULE_DECLARE(status_led);
}

void STATUS_LED::red()
{
  LOG_MODULE_DECLARE(status_led);
}

void STATUS_LED::green()
{
  LOG_MODULE_DECLARE(status_led);
}
```

## src/status_led.h
```c
/*
 * Copyright (c) 2023 Maximilian Huber
 *
 * SPDX-License-Identifier: Apache-2.0
 */
#ifndef __STATUS_LED_H_
#define __STATUS_LED_H_

#include <stdbool.h>
#include <stdio.h>
#include <stdlib.h>
#include <string.h>

#include <errno.h>
#include <zephyr/kernel.h>
#include <zephyr/drivers/led_strip.h>
#include <zephyr/device.h>
#include <zephyr/drivers/spi.h>
#include <zephyr/sys/util.h>

#define DELAY_TIME K_MSEC(50)

#define RGB(_r, _g, _b)                 \
    {                                   \
        .r = (_r), .g = (_g), .b = (_b) \
    }

static const struct led_rgb colors[] = {
    RGB(0x0f, 0x00, 0x00), /* red */
    RGB(0x00, 0x0f, 0x00), /* green */
    RGB(0x00, 0x00, 0x0f), /* blue */
};

class STATUS_LED
{
    const struct device *strip;
    int strip_num_pixels;

public:
    STATUS_LED(const struct device *_strip, int _strip_num_pixels);
    void blue();
    void red();
    void green();
};

#endif // __STATUS_LED_H_
```

## src/uiclient.cpp
```c
/*
 * Copyright (c) 2023 Maximilian Huber
 *
 * SPDX-License-Identifier: Apache-2.0
 */

#include "uiclient.h"
#include <zephyr/logging/log.h>
LOG_MODULE_REGISTER(uiclient, LOG_LEVEL_DBG);

#include <zephyr/kernel.h>
#include <zephyr/net/net_ip.h>
#include <zephyr/net/socket.h>
#include <zephyr/net/tls_credentials.h>
#include <zephyr/net/websocket.h>
#include <zephyr/random/rand32.h>
#include <zephyr/shell/shell.h>

#define MAX_RECV_BUF_LEN 1000 /* TODO */
static uint8_t recv_buf_ipv4[MAX_RECV_BUF_LEN];

/* We need to allocate bigger buffer for the websocket data we receive so that
 * the websocket header fits into it.
 */
#define EXTRA_BUF_SPACE 30
static uint8_t temp_recv_buf_ipv4[MAX_RECV_BUF_LEN + EXTRA_BUF_SPACE];

static int setup_socket(sa_family_t family, const char *server, int port,
                        int *sock, struct sockaddr *addr, socklen_t addr_len)
{
    const char *family_str = family == AF_INET ? "IPv4" : "IPv6";
    int ret = 0;

    memset(addr, 0, addr_len);

    if (family == AF_INET)
    {
        net_sin(addr)->sin_family = AF_INET;
        net_sin(addr)->sin_port = htons(port);
        inet_pton(family, server, &net_sin(addr)->sin_addr);
    }

    *sock = socket(family, SOCK_STREAM, IPPROTO_TCP);

    if (*sock < 0)
    {
        LOG_ERR("Failed to create %s HTTP socket (%d)", family_str,
                -errno);
    }

    return ret;

fail:
    if (*sock >= 0)
    {
        close(*sock);
        *sock = -1;
    }

    return ret;
}

static int connect_socket(sa_family_t family, const char *server, int port,
                          int *sock, struct sockaddr *addr, socklen_t addr_len)
{
    int ret;

    ret = setup_socket(family, server, port, sock, addr, addr_len);
    if (ret < 0 || *sock < 0)
    {
        return -1;
    }

    ret = connect(*sock, addr, addr_len);
    if (ret < 0)
    {
        LOG_ERR("Cannot connect to %s remote (%d)",
                family == AF_INET ? "IPv4" : "IPv6",
                -errno);
        ret = -errno;
    }

    return ret;
}

static int connect_cb(int sock, struct http_request *req, void *user_data)
{
    // LOG_INF("Websocket %d connected.", sock;

    return 0;
}

int UICLIENT::init_socket(void)
{
    const char *extra_headers[] = {
        "Origin: http://foobar\r\n",
        NULL};
    int sock4 = -1;
    int websock4 = -1;
    int32_t timeout = 3 * MSEC_PER_SEC;
    struct sockaddr_in addr4;
    size_t amount;
    int ret;

    (void)connect_socket(AF_INET, ip, port,
                         &sock4, (struct sockaddr *)&addr4,
                         sizeof(addr4));

    if (sock4 < 0)
    {
        LOG_ERR("Cannot create HTTP connection.");
        k_sleep(K_FOREVER);
    }

    struct websocket_request req;

    memset(&req, 0, sizeof(req));

    req.host = ip;
    req.url = "/socket.io/1/websocket";
    req.optional_headers = extra_headers;
    req.cb = connect_cb;
    req.tmp_buf = temp_recv_buf_ipv4;
    req.tmp_buf_len = sizeof(temp_recv_buf_ipv4);

    websock4 = websocket_connect(sock4, &req, timeout, NULL);
    if (websock4 < 0)
    {
        LOG_ERR("Cannot connect to %s:%d", ip, port);
        close(sock4);
    }

    if (websock4 < 0)
    {
        LOG_ERR("No IPv4 or IPv6 connectivity");
        k_sleep(K_FOREVER);
    }

    LOG_INF("Websocket IPv4 %d", websock4);

    return websock4;
}

UICLIENT::UICLIENT(const char *_ip, int _port)
{
    LOG_MODULE_DECLARE(uiclient);
    ip = _ip;
    port = _port;

    socket = init_socket();
}

void UICLIENT::get(int channel)
{
}
```

## src/uiclient.h
```c
/*
 * Copyright (c) 2023 Maximilian Huber
 *
 * SPDX-License-Identifier: Apache-2.0
 */
#ifndef __UICLIENT_H_
#define __UICLIENT_H_

#include <stdbool.h>
#include <stdio.h>
#include <stdlib.h>
#include <string.h>

#include <errno.h>

class UICLIENT
{
    const char *ip;
    int port;
    int socket;

    int init_socket(void);

public:
    UICLIENT(const char *_ip, int _port);
    void get(int channel);
};

#endif // __UICLIENT_H_
```

## src/wifi.cpp
```c
/*
 * Copyright (c) 2023 Maximilian Huber
 * Copyright (c) 2023 Craig Peacock.
 * Copyright (c) 2019 Intel Corporation
 * Copyright (c) 2017 ARM Ltd.
 * Copyright (c) 2016 Intel Corporation.
 *
 * SPDX-License-Identifier: Apache-2.0
 */

#include "wifi.h"
#include <zephyr/logging/log.h>
LOG_MODULE_REGISTER(wifi);

#include <zephyr/sys/reboot.h>

static void handle_wifi_connect_result(struct net_mgmt_event_callback *cb)
{
	const struct wifi_status *status = (const struct wifi_status *)cb->info;

	if (status->status)
	{
		LOG_ERR("Connection request failed (%d)\n", status->status);
	}
	else
	{
		LOG_INF("Connected\n");
		k_sem_give(&wifi_connected);
	}
}

static void handle_wifi_disconnect_result(struct net_mgmt_event_callback *cb)
{
	const struct wifi_status *status = (const struct wifi_status *)cb->info;

	if (status->status)
	{
		LOG_INF("Disconnection request (%d)", status->status);
		LOG_INF("Sleeping 10 sec and then reboot");
		k_sleep(K_SECONDS(10));
		sys_reboot(SYS_REBOOT_WARM);
	}
	else
	{
		LOG_INF("Disconnected\n");
		k_sem_take(&wifi_connected, K_NO_WAIT);
	}
}

static void handle_ipv4_result(struct net_if *iface)
{
	int i = 0;

	for (i = 0; i < NET_IF_MAX_IPV4_ADDR; i++)
	{

		char buf[NET_IPV4_ADDR_LEN];

		if (iface->config.ip.ipv4->unicast[i].addr_type != NET_ADDR_DHCP)
		{
			continue;
		}

		LOG_DBG("IPv4 address: %s\n",
				net_addr_ntop(AF_INET,
							  &iface->config.ip.ipv4->unicast[i].address.in_addr,
							  buf, sizeof(buf)));
		LOG_DBG("Subnet: %s\n",
				net_addr_ntop(AF_INET,
							  &iface->config.ip.ipv4->netmask,
							  buf, sizeof(buf)));
		LOG_DBG("Router: %s\n",
				net_addr_ntop(AF_INET,
							  &iface->config.ip.ipv4->gw,
							  buf, sizeof(buf)));
	}

	k_sem_give(&ipv4_address_obtained);
}

static void wifi_mgmt_event_handler(struct net_mgmt_event_callback *cb, uint32_t mgmt_event, struct net_if *iface)
{
	switch (mgmt_event)
	{

	case NET_EVENT_WIFI_CONNECT_RESULT:
		handle_wifi_connect_result(cb);
		break;

	case NET_EVENT_WIFI_DISCONNECT_RESULT:
		handle_wifi_disconnect_result(cb);
		break;

	case NET_EVENT_IPV4_ADDR_ADD:
		handle_ipv4_result(iface);
		break;

	default:
		break;
	}
}

WIFI::WIFI(const char *_ssid, char *_psk)
{
	LOG_MODULE_DECLARE(wifi);
	ssid = _ssid;
	psk = _psk;

	net_mgmt_init_event_callback(&wifi_cb, wifi_mgmt_event_handler,
								 NET_EVENT_WIFI_CONNECT_RESULT | NET_EVENT_WIFI_DISCONNECT_RESULT);

	net_mgmt_init_event_callback(&ipv4_cb, wifi_mgmt_event_handler, NET_EVENT_IPV4_ADDR_ADD);

	net_mgmt_add_event_callback(&wifi_cb);
	net_mgmt_add_event_callback(&ipv4_cb);
}

void WIFI::status(void)
{
	struct net_if *iface = net_if_get_default();

	struct wifi_iface_status status = {0};

	if (net_mgmt(NET_REQUEST_WIFI_IFACE_STATUS, iface, &status, sizeof(struct wifi_iface_status)))
	{
		LOG_ERR("WiFi Status Request Failed\n");
	}

	if (status.state >= WIFI_STATE_ASSOCIATED)
	{
		LOG_DBG("SSID: %-32s\n", status.ssid);
		LOG_DBG("Band: %s\n", wifi_band_txt(status.band));
		LOG_DBG("Channel: %d\n", status.channel);
		LOG_DBG("Security: %s\n", wifi_security_txt(status.security));
		LOG_DBG("RSSI: %d\n", status.rssi);
	}
}

void WIFI::disconnect(void)
{
	struct net_if *iface = net_if_get_default();

	if (net_mgmt(NET_REQUEST_WIFI_DISCONNECT, iface, NULL, 0))
	{
		LOG_ERR("WiFi Disconnection Request Failed\n");
	}
}
void WIFI::connect()
{
	LOG_MODULE_DECLARE(wifi);

#ifdef CONFIG_BOARD_NRF7002DK_NRF5340_CPUAPP
	// Delay to prevent "Unable to get wpa_s handle for wlan0" on nRF Connect SDK 2.3.0.?
	LOG_DBG("Sleeping for 1 second while wlan0 comes up\n");
	k_sleep(K_SECONDS(1));
#else
	LOG_DBG("Sleeping for 1 second anyways\n");
	k_sleep(K_SECONDS(1));
#endif

	LOG_INF("try to connect to %s\n", ssid);

	struct net_if *iface = net_if_get_default();

	struct wifi_connect_req_params wifi_params = {0};

	wifi_params.ssid = reinterpret_cast<const uint8_t *>(ssid);
	wifi_params.psk = reinterpret_cast<uint8_t *>(psk);
	wifi_params.ssid_length = strlen(ssid);
	wifi_params.psk_length = strlen(psk);
	wifi_params.channel = WIFI_CHANNEL_ANY;
	wifi_params.security = WIFI_SECURITY_TYPE_PSK;
	wifi_params.band = WIFI_FREQ_BAND_2_4_GHZ;
	wifi_params.mfp = WIFI_MFP_OPTIONAL;

	LOG_DBG("Connecting to SSID: %s\n", wifi_params.ssid);

	if (net_mgmt(NET_REQUEST_WIFI_CONNECT, iface, &wifi_params, sizeof(struct wifi_connect_req_params)))
	{
		LOG_ERR("WiFi Connection Request Failed\n");
	}

	k_sem_take(&wifi_connected, K_FOREVER);
	status();
	k_sem_take(&ipv4_address_obtained, K_FOREVER);
	LOG_INF("Ready...");
}
```

## src/wifi.h
```c
/*
 * Copyright (c) 2023 Maximilian Huber
 *
 * SPDX-License-Identifier: Apache-2.0
 */
#ifndef __WIFI_H_
#define __WIFI_H_

#include <stdbool.h>
#include <stdio.h>
#include <stdlib.h>
#include <string.h>

#include <errno.h>
#include <zephyr/kernel.h>
#include <zephyr/net/net_event.h>
#include <zephyr/net/net_if.h>
#include <zephyr/net/net_ip.h>
#include <zephyr/net/wifi_mgmt.h>

static K_SEM_DEFINE(wifi_connected, 0, 1);
static K_SEM_DEFINE(ipv4_address_obtained, 0, 1);

static struct net_mgmt_event_callback wifi_cb;
static struct net_mgmt_event_callback ipv4_cb;

class WIFI
{
  const char *ssid;
  char *psk;

public:
  WIFI(const char *_ssid, char *_psk);
  void connect();
  void status();
  void disconnect();
};

#endif // __WIFI_H_
```
